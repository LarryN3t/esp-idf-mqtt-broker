## main/Kconfig.projbuild
```kconfig
menu "Application Configuration MQTT & WIFI"

	choice WIFI_MODE
		prompt "Wi-Fi Access mode"
		default ST_MODE
		help
			Select Wi-Fi Access mode.
		config ST_MODE
			bool "Station MODE"
			help
				Wi-Fi is Station Mode.
		config AP_MODE
			bool "Access Point MODE"
			help
				Wi-Fi is Access Point Mode.
	endchoice

	config ESP_WIFI_SSID
		string "WiFi SSID"
		default "myssid"
		help
			SSID (network name) for the example to connect to.

	config ESP_WIFI_PASSWORD
		string "WiFi Password"
		default "mypassword"
		help
			WiFi password (WPA or WPA2) for the example to use.

	config ESP_MAX_STA_CONN
		depends on AP_MODE
		int "Maximum STA connections"
		default 4
		help
			Max number of the STA connects to AP.

	config ESP_MAXIMUM_RETRY
		depends on ST_MODE
		int "Maximum number of retries"
		default 5
		help
			Set the Maximum retry to avoid station reconnecting to the AP unlimited when the AP is really inexistent.

	config MDNS_HOSTNAME
		depends on ST_MODE
		string "mDNS Hostname"
		default "esp32-broker"
		help
			mDNS Hostname for example to use

	config STATIC_IP
		depends on ST_MODE
		bool "Enable Static IP Address"
		default false
		help
			Enable Static IP Address.

	config STATIC_IP_ADDRESS
		depends on STATIC_IP
		string "Static IP Address"
		default "192.168.10.100"
		help
			Static IP Address for Station.

	config STATIC_GW_ADDRESS
		depends on STATIC_IP
		string "Static GW Address"
		default "192.168.10.1"
		help
			Static GW Address for Station.

	config STATIC_NM_ADDRESS
		depends on STATIC_IP
		string "Static Netmask"
		default "255.255.255.0"
		help
			Static Netmask for Station.

        config EXAMPLE_MQTT_BROKER_URI
                string "MQTT Broker URL"
                default "mqtt://mqtt.eclipseprojects.io"
                help
                      URL of the mqtt broker which this example connects to.

        config EXAMPLE_MQTT_USERNAME
                string "MQTT Username"
                default "username"
                help
                     MQTT Username.

         config EXAMPLE_MQTT_PASSWORD
                string "MQTT Password"
                default "password"
                help
                  MQTT Password.

	config SUBSCRIBE
		bool "Start MQTT SUBSCRIBER"
		default false
		help
			Start MQTT SUBSCRIBER.

	config PUBLISH
		bool "Start MQTT PUBLISHER"
		default false
		help
			Start MQTT PUBLISHER.

endmenu
menu "MODEM Configuration"

    choice EXAMPLE_SERIAL_CONFIG
        prompt "Type of serial connection to the modem"
        default EXAMPLE_SERIAL_CONFIG_UART
        config EXAMPLE_SERIAL_CONFIG_UART
            bool "UART"
            help
                Connect to modem via UART.
        config EXAMPLE_SERIAL_CONFIG_USB
            bool "USB"
            depends on IDF_TARGET_ESP32S2 || IDF_TARGET_ESP32S3
            help
                Connect to modem via USB (CDC-ACM class). For IDF version >= 4.4.
    endchoice

    choice EXAMPLE_MODEM_DEVICE
        prompt "Choose supported modem device (DCE)"
        default EXAMPLE_MODEM_DEVICE_BG96
        help
            Select modem device connected to the ESP DTE.
        config EXAMPLE_MODEM_DEVICE_SIM800
            depends on EXAMPLE_SERIAL_CONFIG_UART
            bool "SIM800"
            help
                SIMCom SIM800L is a GSM/GPRS module.
                It supports Quad-band 850/900/1800/1900MHz.
        config EXAMPLE_MODEM_DEVICE_BG96
            bool "BG96"
            help
                Quectel BG96 is a series of LTE Cat M1/Cat NB1/EGPRS module.
        config EXAMPLE_MODEM_DEVICE_SIM7000
            depends on EXAMPLE_SERIAL_CONFIG_UART
            bool "SIM7000"
            help
                SIM7000 is a Multi-Band LTE-FDD and GSM/GPRS/EDGE module.
        config EXAMPLE_MODEM_DEVICE_SIM7070
            depends on EXAMPLE_SERIAL_CONFIG_UART
            bool "SIM7070"
            help
                SIM7070 is Multi-Band CAT M and NB IoT module.
        config EXAMPLE_MODEM_DEVICE_SIM7600
            bool "SIM7600"
            help
                SIM7600 is a Multi-Band LTE-TDD/LTE-FDD/HSPA+ and GSM/GPRS/EDGE module.
        config EXAMPLE_MODEM_DEVICE_A7670
            depends on EXAMPLE_SERIAL_CONFIG_USB
            bool "A7670"
            help
                A7670X is Multi-Band LTE-FDD/LTE-TDD/GSM/GPRS/EDGE module.

        config EXAMPLE_MODEM_DEVICE_CUSTOM
            select ESP_MODEM_ADD_CUSTOM_MODULE
            bool "Custom device"
            help
                This demonstrates use of a custom device in C-API.

    endchoice

    config EXAMPLE_MODEM_PPP_APN
        string "Set MODEM APN"
        default "internet"
        help
            Set APN (Access Point Name), a logical name to choose data network

    config EXAMPLE_MODEM_PPP_AUTH_USERNAME
        string "Set username for authentication"
        default "espressif"
        depends on !EXAMPLE_MODEM_PPP_AUTH_NONE
        help
            Set username for PPP Authentication.

    config EXAMPLE_MODEM_PPP_AUTH_PASSWORD
        string "Set password for authentication"
        default "esp32"
        depends on !EXAMPLE_MODEM_PPP_AUTH_NONE
        help
            Set password for PPP Authentication.

    config EXAMPLE_MODEM_PPP_AUTH_NONE
        bool "Skip PPP authentication"
        default n
        help
            Set to true for the PPP client to skip authentication

    config EXAMPLE_SEND_MSG
        bool "Short message (SMS)"
        default n
        help
            Select this, the modem will send a short message before power off.

    if EXAMPLE_SEND_MSG
        config EXAMPLE_SEND_MSG_PEER_PHONE_NUMBER
            string "Peer Phone Number (with area code)"
            default "+8610086"
            help
                Enter the peer phone number that you want to send message to.
    endif

    config EXAMPLE_NEED_SIM_PIN
        bool "SIM PIN needed"
        default n
        help
            Enable to set SIM PIN before starting the example

    config EXAMPLE_SIM_PIN
        string "Set SIM PIN"
        default "1234"
        depends on EXAMPLE_NEED_SIM_PIN
        help
            Pin to unlock the SIM

    menu "UART Configuration"
        depends on EXAMPLE_SERIAL_CONFIG_UART
        config EXAMPLE_MODEM_UART_TX_PIN
            int "TXD Pin Number"
            default 25
            range 0 31
            help
                Pin number of UART TX.

        config EXAMPLE_MODEM_UART_RX_PIN
            int "RXD Pin Number"
            default 26
            range 0 31
            help
                Pin number of UART RX.

        config EXAMPLE_MODEM_UART_RTS_PIN
            int "RTS Pin Number"
            default 27
            range 0 31
            help
                Pin number of UART RTS.

        config EXAMPLE_MODEM_UART_CTS_PIN
            int "CTS Pin Number"
            default 23
            range 0 31
            help
                Pin number of UART CTS.

        config EXAMPLE_MODEM_UART_EVENT_TASK_STACK_SIZE
            int "UART Event Task Stack Size"
            range 2000 6000
            default 2048
            help
                Stack size of UART event task.

        config EXAMPLE_MODEM_UART_EVENT_TASK_PRIORITY
            int "UART Event Task Priority"
            range 3 22
            default 5
            help
                Priority of UART event task.

        config EXAMPLE_MODEM_UART_EVENT_QUEUE_SIZE
            int "UART Event Queue Size"
            range 10 40
            default 30
            help
                Length of UART event queue.

        config EXAMPLE_MODEM_UART_PATTERN_QUEUE_SIZE
            int "UART Pattern Queue Size"
            range 10 40
            default 20
            help
                Length of UART pattern queue.

        config EXAMPLE_MODEM_UART_TX_BUFFER_SIZE
            int "UART TX Buffer Size"
            range 256 2048
            default 512
            help
                Buffer size of UART TX buffer.

        config EXAMPLE_MODEM_UART_RX_BUFFER_SIZE
            int "UART RX Buffer Size"
            range 256 2048
            default 1024
            help
                Buffer size of UART RX buffer.

        choice EXAMPLE_FLOW_CONTROL
            bool "Set preferred modem control flow"
            default EXAMPLE_FLOW_CONTROL_NONE
            help
                Set the modem's preferred control flow

            config EXAMPLE_FLOW_CONTROL_NONE
                bool "No control flow"
            config EXAMPLE_FLOW_CONTROL_SW
                bool "SW control flow"
            config EXAMPLE_FLOW_CONTROL_HW
                bool "HW control flow"
        endchoice

    endmenu

endmenu
```
